## arch/arm/configs/msm8930_melius_ktt_defconfig
```kconfig
CONFIG_MACH_MELIUS_KTT=y
CONFIG_TDMB=y
CONFIG_TDMB_VENDOR_FCI=y
CONFIG_TDMB_FC8050=y
CONFIG_TDMB_SPI=y
CONFIG_TDMB_ANT_DET=y
# CONFIG_FM_RADIO is not set
# CONFIG_FM_SI4705 is not set
# CONFIG_RADIO_USE_MI2S is not set
CONFIG_WCNSS_CCX=y
CONFIG_WCNSS_MEM_PRE_ALLOC=y
# CONFIG_ANDROID_RAM_CONSOLE is not set
CONFIG_SEC_DEBUG_NOCACHE_LOG_IN_LEVEL_LOW=y
CONFIG_SEC_LOG_LAST_KMSG=y


# disable qualcomm thermal monitor
# CONFIG_THERMAL_MONITOR is not set
CONFIG_SEC_DEBUG_LMK_MEMINFO=y
# CONFIG_ANDROID_LOW_MEMORY_KILLER_BASED_MEMUSAGE is not set

# Compcache
CONFIG_SWAP=y
CONFIG_ZRAM=y
CONFIG_ZRAM_DEBUG=y
CONFIG_ZRAM_FOR_ANDROID=y
CONFIG_CGROUP_MEM_RES_CTLR=y
CONFIG_CGROUP_MEM_RES_CTLR_SWAP=y
CONFIG_CGROUP_MEM_RES_CTLR_SWAP_ENABLED=y

CONFIG_USER_RESET_DEBUG=y
CONFIG_SEC_OOM_KILLER=y

#SOUND
CONFIG_SEC_DEVIDE_RINGTONE_GAIN=y
```

## arch/arm/configs/msm8930_melius_mtr_defconfig
```kconfig
CONFIG_MACH_MELIUS_MTR=y
CONFIG_MSM_AVS_HW=n
CONFIG_WCNSS_CCX=y
CONFIG_SEC_PERIPHERAL_SECURE_CHK=y
```
